## dts/bindings/behaviors/cygnus,auto-click.yaml
```yaml
description: Toggle one left click every five seconds.
compatible: "cygnus,auto-click"
include: zero_param.yaml
```

## dts/bindings/behaviors/cygnus,mouse-jiggle.yaml
```yaml
description: Toggle a small cursor movement every three minutes.
compatible: "cygnus,mouse-jiggle"
include: zero_param.yaml
```

## dts/bindings/input/cygnus,arrow-gesture.yaml
```yaml
description: Convert horizontal trackball motion into one arrow key while the gesture key is held.
compatible: "cygnus,arrow-gesture"
include: ip_zero_param.yaml
```
